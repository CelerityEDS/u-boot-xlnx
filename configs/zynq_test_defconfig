## configs/zynq_test_defconfig
```kconfig
CONFIG_ARM=y
CONFIG_ARCH_ZYNQ=y
CONFIG_TARGET_ZYNQ_ZC702=y
CONFIG_ZYNQ_CUSTOM_INIT=y
CONFIG_SYS_SPI_U_BOOT_OFFS=0x80000
CONFIG_DEFAULT_DEVICE_TREE="system"
# CONFIG_SYS_MALLOC_F is not set
CONFIG_FIT=y
CONFIG_FIT_VERBOSE=y
CONFIG_FIT_SIGNATURE=y
# CONFIG_CMD_IMLS is not set
# CONFIG_CMD_SETEXPR is not set
CONFIG_OF_EMBED=y
CONFIG_SPI_FLASH=y
CONFIG_SPI_FLASH_BAR=y
CONFIG_ZYNQ_SERIAL_UART0=y
```
